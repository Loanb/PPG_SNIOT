## build/Kconfig/Kconfig.modules
```kconfig
menu "sniot_zephyr_template (/home/seatech/Documents/my-workspace/sniot_zephyr_template)"
osource "/home/seatech/Documents/my-workspace/sniot_zephyr_template/Kconfig"
config ZEPHYR_SNIOT_ZEPHYR_TEMPLATE_MODULE
	bool
	default y
endmenu
menu "cmsis-dsp (/home/seatech/Documents/my-workspace/modules/lib/cmsis-dsp)"
osource "$(ZEPHYR_CMSIS_DSP_KCONFIG)"
config ZEPHYR_CMSIS_DSP_MODULE
	bool
	default y
endmenu
menu "cmsis_6 (/home/seatech/Documents/my-workspace/modules/hal/cmsis_6)"
osource "$(ZEPHYR_CMSIS_6_KCONFIG)"
config ZEPHYR_CMSIS_6_MODULE
	bool
	default y
endmenu
menu "hal_espressif (/home/seatech/Documents/my-workspace/modules/hal/espressif)"
osource "/home/seatech/Documents/my-workspace/modules/hal/espressif/zephyr/Kconfig"
config ZEPHYR_HAL_ESPRESSIF_MODULE
	bool
	default y
	select TAINT_BLOBS

config ZEPHYR_HAL_ESPRESSIF_MODULE_BLOBS
	bool
	default y
endmenu
menu "hal_nordic (/home/seatech/Documents/my-workspace/modules/hal/nordic)"
osource "$(ZEPHYR_HAL_NORDIC_KCONFIG)"
config ZEPHYR_HAL_NORDIC_MODULE
	bool
	default y

config ZEPHYR_HAL_NORDIC_MODULE_BLOBS
	bool
endmenu
config ZEPHYR_HAL_STM32_MODULE
	bool
	default y

config ZEPHYR_HAL_STM32_MODULE_BLOBS
	bool
config ZEPHYR_XTENSA_MODULE
	bool
	default y
menu "mbedtls (/home/seatech/Documents/my-workspace/modules/crypto/mbedtls)"
osource "$(ZEPHYR_MBEDTLS_KCONFIG)"
config ZEPHYR_MBEDTLS_MODULE
	bool
	default y
endmenu
```

## build/Kconfig/Kconfig.shield
```kconfig
osource "/home/seatech/Documents/my-workspace/sniot_zephyr_template/boards/shields/*/Kconfig.shield"
```

## build/Kconfig/Kconfig.sysbuild.modules
```kconfig
config ZEPHYR_SNIOT_ZEPHYR_TEMPLATE_MODULE
   bool
   default y
config ZEPHYR_CMSIS_DSP_MODULE
   bool
   default y
config ZEPHYR_CMSIS_6_MODULE
   bool
   default y
config ZEPHYR_HAL_ESPRESSIF_MODULE
   bool
   default y
config ZEPHYR_HAL_NORDIC_MODULE
   bool
   default y
config ZEPHYR_HAL_STM32_MODULE
   bool
   default y
config ZEPHYR_XTENSA_MODULE
   bool
   default y
config ZEPHYR_MBEDTLS_MODULE
   bool
   default y
```

## build/Kconfig/arch/Kconfig
```kconfig
# Load Zephyr Arch Kconfig descriptions.
osource "/home/seatech/Documents/my-workspace/zephyr/arch/rx/Kconfig"
osource "/home/seatech/Documents/my-workspace/zephyr/arch/x86/Kconfig"
osource "/home/seatech/Documents/my-workspace/zephyr/arch/xtensa/Kconfig"
osource "/home/seatech/Documents/my-workspace/zephyr/arch/sparc/Kconfig"
osource "/home/seatech/Documents/my-workspace/zephyr/arch/riscv/Kconfig"
osource "/home/seatech/Documents/my-workspace/zephyr/arch/posix/Kconfig"
osource "/home/seatech/Documents/my-workspace/zephyr/arch/mips/Kconfig"
osource "/home/seatech/Documents/my-workspace/zephyr/arch/arm64/Kconfig"
osource "/home/seatech/Documents/my-workspace/zephyr/arch/arm/Kconfig"
osource "/home/seatech/Documents/my-workspace/zephyr/arch/arc/Kconfig"
```

## build/Kconfig/boards/Kconfig
```kconfig
# Load Zephyr board Kconfig descriptions.
osource "/home/seatech/Documents/my-workspace/zephyr/boards/espressif/esp32_devkitc/Kconfig"
```

## build/Kconfig/boards/Kconfig.defconfig
```kconfig
# Load Zephyr board defconfig descriptions.
osource "/home/seatech/Documents/my-workspace/zephyr/boards/espressif/esp32_devkitc/Kconfig.defconfig"
```

## drivers/sensor/Kconfig
```kconfig
# Copyright (c) 2021 Nordic Semiconductor ASA
# SPDX-License-Identifier: Apache-2.0

if SENSOR
rsource "example_sensor/Kconfig"
rsource "max30102/Kconfig"
endif # SENSOR
```
